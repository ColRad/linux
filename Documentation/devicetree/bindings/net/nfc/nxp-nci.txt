## drivers/nfc/Kconfig.rej
```kconfig
--- drivers/nfc/Kconfig
+++ drivers/nfc/Kconfig
@@ -59,5 +59,6 @@
 source "drivers/nfc/pn544/Kconfig"
 source "drivers/nfc/microread/Kconfig"
 source "drivers/nfc/nfcmrvl/Kconfig"
+source "drivers/nfc/nxp-nci/Kconfig"
 
 endmenu
```
